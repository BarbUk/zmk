## app/boards/shields/m60/Kconfig.defconfig
```kconfig
# Copyright (c) 2020 The ZMK Contributors
# SPDX-License-Identifier: MIT

if SHIELD_M60

config ZMK_KEYBOARD_NAME
    default "m60"

if ZMK_RGB_UNDERGLOW

config SPI
    default n

config ZMK_RGB_UNDERGLOW_EXT_POWER
    default n

endif # ZMK_RGB_UNDERGLOW

endif
```

## app/module/drivers/led_strip/Kconfig
```kconfig
# Copyright (c) 2026 The ZMK Contributors
# SPDX-License-Identifier: MIT

if LED_STRIP

rsource "Kconfig.is31fl3733"

endif # LED_STRIP
```

## app/module/drivers/led_strip/Kconfig.is31fl3733
```kconfig
# Copyright (c) 2026 The ZMK Contributors
# SPDX-License-Identifier: MIT

DT_COMPAT_ZMK_IS31FL3733_STRIP := zmk,is31fl3733-strip

config IS31FL3733_STRIP
    bool "IS31FL3733 RGB LED matrix strip driver"
    default $(dt_compat_enabled,$(DT_COMPAT_ZMK_IS31FL3733_STRIP))
    depends on I2C
    help
      Enable LED strip driver for the Lumissil IS31FL3733 12x16 LED matrix.
```

## app/module/dts/bindings/led_strip/zmk,is31fl3733-strip.yaml
```yaml
# Copyright (c) 2026 The ZMK Contributors
# SPDX-License-Identifier: MIT

description: ISSI IS31FL3733 RGB LED Matrix Strip Driver

compatible: "zmk,is31fl3733-strip"

include: "i2c-device.yaml"

properties:
  chain-length:
    type: int
    required: true
    description: Number of RGB pixels controlled by the matrix (up to 64).

  sdb-gpios:
    type: phandle-array
    description: Hardware shutdown / power enable pin (active high).

  current-limit:
    type: int
    default: 128
    description: Global current control register value (0..255).

  sync-mode:
    type: string
    default: "none"
    enum:
      - "none"
      - "master"
      - "slave"
    description: Multi-device clock synchronization mode.

  sw-pullup:
    type: int
    default: 0
    description: |
      SWy pull-up resistor selection (Page 3, 0x0F, bits D2:D0):
      0=none, 1=0.5k, 2=1k, 3=2k, 4=4k, 5=8k, 6=16k, 7=32k.

  cs-pulldown:
    type: int
    default: 0
    description: |
      CSx pull-down resistor selection (Page 3, 0x10, bits D2:D0):
      0=none, 1=0.5k, 2=1k, 3=2k, 4=4k, 5=8k, 6=16k, 7=32k.
```
