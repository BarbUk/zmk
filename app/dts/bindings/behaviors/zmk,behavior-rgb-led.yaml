## app/dts/bindings/behaviors/zmk,behavior-rgb-led.yaml
```yaml
# Copyright (c) 2020 The ZMK Contributors
# SPDX-License-Identifier: MIT

description: RGB Underglow Action

compatible: "zmk,behavior-rgb-led"

include: two_param.yaml
```
