/*
 * Copyright (c) 2020 The ZMK Contributors
 *
 * SPDX-License-Identifier: MIT
 */

/ {
    behaviors {
        // Behavior can be invoked on peripherals, so name must be <= 8 characters.
        rgb_led: rgb_led {
            compatible = "zmk,behavior-rgb-led";
            #binding-cells = <2>;
            display-name = "Led";
        };
    };
};
